/*
 * Copyright (c) 2020 Pete Johanson
 *
 * SPDX-License-Identifier: MIT
 */

#include "lily58.dtsi"

&kscan0 {
    col-gpios
        = <&pro_micro 19 GPIO_ACTIVE_HIGH>
        , <&pro_micro 18 GPIO_ACTIVE_HIGH>
        , <&pro_micro 15 GPIO_ACTIVE_HIGH>
        , <&pro_micro 14 GPIO_ACTIVE_HIGH>
        , <&pro_micro 16 GPIO_ACTIVE_HIGH>
        , <&pro_micro 10 GPIO_ACTIVE_HIGH>
        ;
};

&left_encoder {
    status = "okay";
};
&pro_micro_i2c {
    status = "okay";

    oled: ssd1306@3c {
        /* SSD1312 sürücüsü SSD1306 komutlarıyla büyük oranda uyumludur */
        /* Ancak tam uyum için compatible değerini değiştirmeyi deneyin */
        compatible = "solomon,ssd1306fb"; 
        reg = <0x3c>;
        width = <128>;
        height = <64>; // Lily58 genelde 32 kullanır, ekranınız 64 ise bunu güncelleyin
        segment-offset = <0>;
        page-offset = <0>;
        display-offset = <0>;
        multiplex-ratio = <63>;
        segment-remap;
        com-invdir;
        prechargep = <0x22>;
    };
};
